## boards/arm/marvelous65/Kconfig.board
```kconfig
# SPDX-License-Identifier: MIT

config BOARD_MARVELOUS65
	bool "Marvelous65"
	depends on SOC_NRF52840_QIAA
```

## boards/arm/marvelous65_ergo/Kconfig.board
```kconfig
# SPDX-License-Identifier: MIT

config BOARD_MARVELOUS65_ERGO
	bool "Marvelous65 Ergo"
	depends on SOC_NRF52840_QIAA
```

## boards/arm/marvelous65_ergo/Kconfig.defconfig
```kconfig
# SPDX-License-Identifier: MIT

if BOARD_MARVELOUS65_ERGO
config BOARD
	default "marvelous65_ergo"

config ZMK_KEYBOARD_NAME
    default "Marvelous65 Ergo"

if USB_DEVICE_STACK

config USB_NRFX
    default y

endif # USB_DEVICE_STACK

config BT_CTLR
    default BT

config ZMK_USB
    default y

config ZMK_BATTERY_VOLTAGE_DIVIDER
    default y

endif # BOARD_MARVELOUS65_ERGO
```

## boards/karnadii/geulis/board.yml
```yaml
board:
  name: geulis
  vendor: karnadii
  socs:
    - name: nrf52840
      variants:
        - name: zmk
```

## module/Kconfig
```kconfig
# SPDX-License-Identifier: MIT

config ZMK_INDICATOR_LEDS
    bool "zmk,indicator-leds driver"
    default y
    depends on DT_HAS_ZMK_INDICATOR_LEDS_ENABLED
    help
      Build the backport of the zmk,indicator-leds GPIO driver for ZMK v0.3.
      Activated automatically when a node with compatible
      "zmk,indicator-leds" is present in the devicetree.
```

## module/dts/bindings/zmk,indicator-leds.yaml
```yaml
description: ZMK HID/layer indicator LED driver (backport for ZMK v0.3)

compatible: "zmk,indicator-leds"

child-binding:
  description: |
    An entry mapping either a HID indicator bit or an active layer to
    one or more GPIO LEDs. Exactly one of `indicator` or `layer` must
    be set.

    `leds` is an array of phandles to existing `gpio-leds` children
    (the same nodes bound by the standard Zephyr GPIO LED driver).
    Multiple LEDs are driven in parallel (e.g. wire two LEDs to the
    same indicator).
  compatible: "zmk,indicator-leds-entry"

  properties:
    indicator:
      type: int
      required: false
      description: |
        HID indicator bit number (0..7). 0 = Num Lock, 2 = Caps Lock,
        3 = Scroll Lock, 4 = Compose, 5 = Kana. Mutually exclusive
        with `layer`.
    layer:
      type: int
      required: false
      description: |
        Zero-based keymap layer index. The LED is on whenever this
        layer is the highest active one. Mutually exclusive with
        `indicator`.
    leds:
      type: phandles
      required: true
      description: |
        Phandles to one or more `gpio-leds` children, each specifying
        a `gpios` property. The driver reconfigures those pins as
        outputs and drives them directly.
```
